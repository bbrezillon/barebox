## arch/arm/configs/sunxi_defconfig
```kconfig
CONFIG_ARCH_SUNXI=y
CONFIG_AEABI=y
CONFIG_ARM_UNWIND=y
CONFIG_PROMPT="barebox"
CONFIG_GLOB=y
CONFIG_GLOB_SORT=y
CONFIG_CMDLINE_EDITING=y
CONFIG_AUTO_COMPLETE=y
CONFIG_CONSOLE_SIMPLE=y
# CONFIG_DEFAULT_ENVIRONMENT is not set
CONFIG_DEBUG_INFO=y
CONFIG_DEBUG_LL=y
CONFIG_DEBUG_SUNXI_UART1=y
CONFIG_FLEXIBLE_BOOTARGS=y
CONFIG_CMD_BOOT=y
CONFIG_CMD_AUTOMOUNT=y
CONFIG_CMD_EXPORT=y
CONFIG_CMD_GLOBAL=y
CONFIG_CMD_BASENAME=y
CONFIG_CMD_DIRNAME=y
CONFIG_CMD_READLINK=y
CONFIG_CMD_ECHO_E=y
CONFIG_CMD_TIMEOUT=y
CONFIG_CMD_CRC=y
CONFIG_CMD_CRC_CMP=y
CONFIG_DRIVER_SERIAL_NS16550=y
```

## arch/arm/mach-sunxi/Kconfig
```kconfig
if ARCH_SUNXI

config ARCH_TEXT_BASE
	hex
	default 0x4a000000

config BUILTIN_DTB_NAME
	string
	default "sun5i-a13-olinuxino" if MACH_SUN5I_A13_OLINUXINO

comment "sunxi SoC families"

config MACH_SUN4I
	bool "sun4i"

config MACH_SUN5I
	bool "sun5i"

config MACH_SUN6I
	bool "sun6i"

config MACH_SUN7I
	bool "sun7i"

config MACH_SUN8I
	bool "sun8i"

config MACH_SUN9I
	bool "sun9i"

comment "sun5i based boards"

config MACH_SUN5I_A13_OLINUXINO
	bool "Olimex A13-Olinuxino"
	depends on MACH_SUN5I

endif # ARCH_SUNXI
```

## drivers/soc/Kconfig
```kconfig
menu "SOC (System On Chip) specific Drivers"

source "drivers/soc/sunxi/Kconfig"

endmenu
```
